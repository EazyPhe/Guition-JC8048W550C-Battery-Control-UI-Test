## sdkconfig.defaults
```kconfig
# ESP32-S3 configs
CONFIG_ESP32S3_DEFAULT_CPU_FREQ_240=y
CONFIG_ESP32S3_SPIRAM_SUPPORT=y

# Flash configs
CONFIG_ESPTOOLPY_FLASHSIZE_16MB=y
CONFIG_PARTITION_TABLE_CUSTOM=n
CONFIG_PARTITION_TABLE_TWO_OTA=n
CONFIG_PARTITION_TABLE_SINGLE_APP=y

# FreeRTOS configs
CONFIG_FREERTOS_HZ=1000

# LVGL configs
CONFIG_LV_COLOR_16_SWAP=y

# LCD configs
CONFIG_LCD_PANEL_IO_FORMAT_BRG_RGB=n
CONFIG_LCD_RGB_ISR_IRAM_SAFE=y
CONFIG_LCD_RGB_REFRESH_ON_DEMAND=n

# Touch configs
CONFIG_ESP_LCD_TOUCH_MAX_POINTS=1
CONFIG_ESP_LCD_TOUCH_MAX_BUTTONS=0
```
